/* Copyright (c) 2020, Pixelworks
 *
 * This program is free software; you can redistribute it and/or modify
 * it under the terms of the GNU General Public License version 2 and
 * only version 2 as published by the Free Software Foundation.
 *
 * This program is distributed in the hope that it will be useful,
 * but WITHOUT ANY WARRANTY; without even the implied warranty of
 * MERCHANTABILITY or FITNESS FOR A PARTICULAR PURPOSE.  See the
 * GNU General Public License for more details.
 */

&dsi_oplus20828samsung_amb655x_1080_2400_cmd {
	pxlw,soft-iris-enable;
};
&mdss_mdp {
	pxlw,dsi-display-primary-active = "qcom,mdss_dsi_oplus20828samsung_amb655x_1080_2400_cmd";
};
