/* Copyright (c) 2020, Pixelworks
 *
 * This program is free software; you can redistribute it and/or modify
 * it under the terms of the GNU General Public License version 2 and
 * only version 2 as published by the Free Software Foundation.
 *
 * This program is distributed in the hope that it will be useful,
 * but WITHOUT ANY WARRANTY; without even the implied warranty of
 * MERCHANTABILITY or FITNESS FOR A PARTICULAR PURPOSE.  See the
 * GNU General Public License for more details.
 */

&dsi_oplus19811_samsung_1440_3168_dsc_cmd {
	pxlw,iris-chip-enable;
	pxlw,soft-iris-enable;
	qcom,iris-supply-entries = <&dsi_iris_pwr_supply>;
	qcom,dsi-select-clocks = "mux_byte_clk0", "mux_pixel_clk0","pw_bb_clk2";
};
&mdss_mdp {
	pxlw,dsi-display-primary-active = "qcom,mdss_dsi_oplus19811_samsung_1440_3168_dsc_cmd";
};
